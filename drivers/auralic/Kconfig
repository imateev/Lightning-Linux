## drivers/auralic/Kconfig
```kconfig
menuconfig AURALIC_DRIVERS 
	bool "AURALiC drivers support"

if AURALIC_DRIVERS 
	  
config AURALIC_LEDS
	tristate "LED Support for AURALiC"
	select LEDS_GPIO
    help
	  This option enables support for the LEDs of AURALIC.	  

#config AURALIC_BUTTONS 
#	tristate "Buttons Support for AURALiC"
#    select KEYBOARD_GPIO
#	help
#	  This option enables support for the Buttons of AURALIC.	  

config AURALIC_DAC 
	tristate "DAC Support for AURALiC"
	help
	  This option enables support for the Buttons of AURALIC.	  

config AURALIC_ISP 
	tristate "ATMEL MCU ISP Support for AURALiC"
	help
	  This option enables support for the Buttons of AURALIC.	  

config EXFAT_FS 
	tristate "EXFAT fs Support for AURALiC"
	help
	  This option enables support for the Buttons of AURALIC.	  

config AURALIC_SND_USB_HIFACE 
	tristate "SND_USB_HIFACE driver Support for AURALiC"
	help
	  This option enables support for the Buttons of AURALIC.	  

config AURALIC_SND_USB_MYTEK 
	tristate "SND_USB_MYTEK driver Support for AURALiC"
	help
	  This option enables support for the Buttons of AURALIC.	  

config AURALIC_DISK_NAME_BIND 
	tristate "start/stop & diskname binding Support for AURALiC"
	help
	  This option enables tart/stop & diskname binding for AURALIC.	  

config AURALIC_ETH_RESET 
	tristate "add eth0 reset pin Support for AURALiC"
	help
	  This option add eth0 reset pin Support for AURALiC.	  

config AURALIC_USB_BEST_CONFIG 
	tristate "forcely take config0 as USB best config for AURALiC"
	help
	  This option enables support for the Buttons of AURALIC.	  

#config STATIC_MMC_HOST_ID 
#	tristate "use static host id for mmc for AURALiC"
#	help
#	  This option enables support for the Buttons of AURALIC.	  
#
config STATIC_MMCBLK_IDX 
	tristate "use static mmcblk index for mmc block dev for AURALiC"
	help
	  This option enables support for the Buttons of AURALIC.	  

#config HFSPLUS_JOURNAL_CHECK 
#	tristate "check journal consistant but not repare for AURALiC"
#	help
#	  This option enables support for the Buttons of AURALIC.	  


endif # AURALIC_DRIVERS 
```
